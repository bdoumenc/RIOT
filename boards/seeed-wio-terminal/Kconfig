## boards/seeed-wio-terminal/Kconfig
```kconfig
# Copyright (c) 2020 HAW Hamburg
#
# This file is subject to the terms and conditions of the GNU Lesser
# General Public License v2.1. See the file LICENSE in the top level
# directory for more details.
#

config BOARD
    default "seeed-wio-terminal" if BOARD_SEED_WIO_TERMINAL

config BOARD_SEED_WIO_TERMINAL
    bool
    default y
    select CPU_MODEL_SAMD51P19A

# source "$(RIOTBOARD)/common/arduino-zero/Kconfig"
```
